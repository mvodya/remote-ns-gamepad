## main/Kconfig.projbuild
```kconfig
menu "Remote NS Gamepad Config"

  menu "USB HID"
    menu "String Descriptor"
      config NSG_HID_STRDESC_MANUFACTURER
        string "Manufacturer"
        default "mvodya"
        help
          USB string descriptor identifying the manufacturer of the device.
          Appears in system device information and is useful for debugging or distinguishing between different vendors.
      
      config NSG_HID_STRDESC_PRODUCT
        string "Product"
        default "WEB USB NS Gamepad"
        help
          USB string descriptor specifying the product name.
          Shown in the operating system when the device is connected.
      
      config NSG_HID_STRDESC_SERIAL
        string "Serial"
        default "123456"
        help
          USB string descriptor with the device serial number.
          Should be unique per device to allow the OS to differentiate between multiple units of the same product.
      
      config NSG_HID_STRDESC_HID
        string "HID"
        default "WEB USB NS Gamepad"
        help
          USB string descriptor used specifically for the HID interface.
          Typically matches the product name, but can be customized to reflect a specific HID profile.

    endmenu

    config NSG_HID_AUTO_INIT_AFTER_MOUNT
      bool "Auto init gamepad after connect"
      default y
        help
          When enabled, gamepad automatically send an initial "button press" report after USB enumeration.  
          This is required for the Nintendo Switch to recognize and display the controller in the system menu.  

          If disabled, the controller will not appear until the user manually presses at least one button.  

    config NSG_HID_POOLING_TICKRATE_MS
      int "Pooling tickrate (ms)"
      range 1 1000
      default 10
      help
        Interval in milliseconds between HID reports sent over USB. 
    endmenu

  menu "WiFi Connection"

  config NSG_WIFI_SSID
    string "WiFi SSID"
    default "wifissid"
    help
      SSID (network name) for connect to
  
  config NSG_WIFI_PASSWORD
    string "WiFi Password"
    default "password"
    help
      WiFi password (WPA or WPA2) for connect

  choice NSG_WIFI_SCAN_AUTH_MODE_THRESHOLD
    prompt "WiFi Scan auth mode threshold"
    default NSG_WIFI_AUTH_WPA2_PSK
    help
      The weakest authmode to accept in the scan mode.
      This value defaults to NSG_WIFI_AUTH_WPA2_PSK in case password is present and NSG_WIFI_AUTH_OPEN is used.
      Please select NSG_WIFI_AUTH_WEP/NSG_WIFI_AUTH_WPA_PSK in case AP is operating in WEP/WPA mode.

    config NSG_WIFI_AUTH_OPEN
      bool "OPEN"
    config NSG_WIFI_AUTH_WEP
      bool "WEP"
    config NSG_WIFI_AUTH_WPA_PSK
      bool "WPA PSK"
    config NSG_WIFI_AUTH_WPA2_PSK
      bool "WPA2 PSK"
    config NSG_WIFI_AUTH_WPA_WPA2_PSK
      bool "WPA/WPA2 PSK"
    config NSG_WIFI_AUTH_WPA3_PSK
      bool "WPA3 PSK"
    config NSG_WIFI_AUTH_WPA2_WPA3_PSK
      bool "WPA2/WPA3 PSK"
    config NSG_WIFI_AUTH_WAPI_PSK
      bool "WAPI PSK"
    endchoice

    config NSG_WIFI_MAXIMUM_RETRY
      int "Maximum retry to connect WiFi AP"
      default 10
      help
        Set the Maximum retry to avoid station reconnecting to the AP unlimited when the AP is really inexistent.

  endmenu

endmenu
```
